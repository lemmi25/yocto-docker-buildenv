## conf/bblayers.conf
```bitbake
# POKY_BBLAYERS_CONF_VERSION is increased each time build/conf/bblayers.conf
# changes incompatibly
POKY_BBLAYERS_CONF_VERSION = "2"

BBPATH = "${TOPDIR}"
BBFILES ?= ""

BBLAYERS ?= " \
  /opt/yocto/poky/meta \
  /opt/yocto/poky/meta-poky \
  /opt/yocto/poky/meta-yocto-bsp \
  /opt/yocto/meta-raspberrypi \
  /opt/yocto/meta-openembedded/meta-oe \
  /opt/yocto/meta-openembedded/meta-multimedia \
  /opt/yocto/meta-openembedded/meta-networking \
  /opt/yocto/meta-rauc-community/meta-rauc-raspberrypi \ 
  /opt/yocto/meta-rauc \
  /opt/yocto/meta-openembedded/meta-python \
  /home/custom-layer/meta-custom-python \
  "
```

## custom-layer/meta-custom-python/conf/layer.conf
```bitbake
# We have a conf and classes directory, add to BBPATH
BBPATH .= ":${LAYERDIR}"

# We have recipes-* directories, add to BBFILES
BBFILES += "${LAYERDIR}/recipes-*/*/*.bb \
            ${LAYERDIR}/recipes-*/*/*.bbappend"

BBFILE_COLLECTIONS += "meta-custom-python"
BBFILE_PATTERN_meta-custom-python = "^${LAYERDIR}/"
BBFILE_PRIORITY_meta-custom-python = "6"

LAYERDEPENDS_meta-custom-python = "core"
LAYERSERIES_COMPAT_meta-custom-python = "dunfell hardknott"
```

## custom-layer/meta-networkstuff/conf/layer.conf
```bitbake
# We have a conf and classes directory, add to BBPATH
BBPATH .= ":${LAYERDIR}"

# We have recipes-* directories, add to BBFILES
BBFILES += "${LAYERDIR}/recipes-*/*/*.bb \
            ${LAYERDIR}/recipes-*/*/*.bbappend"

BBFILE_COLLECTIONS += "meta_stargazer"
BBFILE_PATTERN_meta_stargazer = "^${LAYERDIR}/"
BBFILE_PRIORITY_meta_stargazer = "6"

LAYERDEPENDS_meta_stargazer = "core"
LAYERSERIES_COMPAT_meta_stargazer = "dunfell"
```
